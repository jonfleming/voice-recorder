## main/Kconfig.projbuild
```kconfig
menu "Voice Recorder Config"

    choice TARGET_BOARD
        prompt "Target Waveshare board"
        default TARGET_BOARD_1_8
        help
            Select the Waveshare AMOLED board variant. Each generates a
            separate binary (different resolution, display init cmds,
            touch/I2S pinout). Leave at 1.8" for current hardware.

        config TARGET_BOARD_1_8
            bool "Waveshare ESP32-S3 AMOLED 1.8\" 368x448 (CO5300)"
        config TARGET_BOARD_2_06
            bool "Waveshare ESP32-S3 AMOLED 2.06\" 410x502 (CO5300 / SH8601)"
    endchoice

    config RECORDER_SAMPLE_RATE
        int "Recorder sample rate"
        default 16000

    config RECORDER_BITS_PER_SAMPLE
        int "Bits per sample"
        default 16

    config RECORDER_CHANNELS
        int "Channels"
        default 1

    config BUTTON_A_GPIO
        int "Button A GPIO (record start/stop)"
        default 0
        help
            BOOT button on Waveshare board. Pull-up, active low.

    config BUTTON_B_GPIO
        int "Button B GPIO (playback)"
        default 21
        help
            Touch INT or spare GPIO. Set to -1 to disable if conflicting.

    config BUTTON_DEBOUNCE_MS
        int "Button debounce ms"
        default 50

    config BUTTON_SHORT_PRESS_MS
        int "Short press threshold ms"
        default 50

    config BUTTON_LONG_PRESS_MS
        int "Long press threshold ms"
        default 1000

endmenu
```
